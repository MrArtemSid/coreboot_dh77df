## dh77df/Kconfig
```kconfig
if BOARD_INTEL_DH77DF

config BOARD_SPECIFIC_OPTIONS
	def_bool y
	select BOARD_ROMSIZE_KB_8192
	select HAVE_ACPI_RESUME
	select HAVE_ACPI_TABLES
	select INTEL_INT15
	select INTEL_GMA_HAVE_VBT
	select MAINBOARD_HAS_LIBGFXINIT
	select NORTHBRIDGE_INTEL_SANDYBRIDGE
	select SERIRQ_CONTINUOUS_MODE
	select SOUTHBRIDGE_INTEL_C216
	select USE_NATIVE_RAMINIT

config MAINBOARD_DIR
	string
	default "intel/dh77df"

config MAINBOARD_PART_NUMBER
	string
	default "DH77DF"

config VGA_BIOS_ID
	string
	default "8086,0152"

config DRAM_RESET_GATE_GPIO # FIXME: check this
	int
	default 60

config USBDEBUG_HCD_INDEX # FIXME: check this
	int
	default 2
endif
```
